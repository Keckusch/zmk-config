&spi1 {
    nice_view_spi: nice_view_spi {
        compatible = "zephyr,spi-device";
        reg = <0>;
        spi-max-frequency = <8000000>;
        cs-gpios = <&pro_micro 6 GPIO_ACTIVE_HIGH>;
    };
};
